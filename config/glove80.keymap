/*
 * Copyright (c) 2020 The ZMK Contributors
 * Copyright (c) 2023 Innaworks Development Limited, trading as MoErgo
 *
 * SPDX-License-Identifier: MIT
 */
/* THIS FILE WAS GENERATED BY GLOVE80 LAYOUT EDITOR
 *
 * This file was generated automatically. You may or may not want to
 * edit it directly.
 */
/* Include all behavior includes needed */

#include <behaviors.dtsi>
#include <dt-bindings/zmk/bt.h>
#include <dt-bindings/zmk/keys.h>
#include <dt-bindings/zmk/outputs.h>
#include <dt-bindings/zmk/rgb.h>

#define HOST_OS 2
#include "zmk-helpers/helper.h"
#include "zmk-helpers/key-labels/glove80.h"
#include "zmk-helpers/unicode-chars/swedish.dtsi"

/* layer names */

#define BASE 0
#define MEDIA 1
#define LOWER 2
#define MAGIC 3
#define CURSOR 4
#define WORLD 5
#define SYMBOLS 6
#define MOUSE 7
#define GAMING 8

#include "mouse.dtsi"
#include "colors.h"
#include "bluetooth.dtsi"
#include "behaviors/swedish_caps_word.dtsi"
#define QUICK_TAP_MS 175

&sk {  // sticky-key config
    release-after-ms = <900>;  // release after 0.6s
    quick-release;             // no double capitalization when rolling keys
};

&sl {  // sticky-layer config
    ignore-modifiers;          // allow chording sticky mods & layers
};

&lt {  // layer-tap config
    flavor = "balanced";
    tapping-term-ms = <200>;
    quick-tap-ms = <QUICK_TAP_MS>;
};

#define KEYS_L LT0 LT1 LT2 LT3 LT4 LM0 LM1 LM2 LM3 LM4 LB0 LB1 LB2 LB3 LB4 LN0 LN1 LN2 LN3 LN4 LN5 // left hand
#define KEYS_R RT0 RT1 RT2 RT3 RT4 RM0 RM1 RM2 RM3 RM4 RB0 RB1 RB2 RB3 RB4 RN0 RN1 RN2 RN3 RN4 RN5 // right hand
#define THUMBS LH5 LH4 LH3 LH2 LH1 LH0 RH0 RH1 RH2 RH3 RH4 RH5              // thumbs

#define MAKE_HRM(NAME, HOLD, TAP, TRIGGER_POS) \
    ZMK_HOLD_TAP(NAME, \
        flavor = "balanced"; \
        tapping-term-ms = <280>; \
        quick-tap-ms = <QUICK_TAP_MS>; \
        require-prior-idle-ms = <150>; \
        bindings = <HOLD>, <TAP>; \
        hold-trigger-key-positions = <TRIGGER_POS>; \
        hold-trigger-on-release; \
    )
MAKE_HRM(hml, &kp, &kp, KEYS_R THUMBS)  // left-hand HRMs
MAKE_HRM(hmr, &kp, &kp, KEYS_L THUMBS)  // right-hand HRMs

MAKE_HRM(hml_repeat, &kp, &key_repeat, KEYS_R THUMBS)  // used for HRM-combo
//MAKE_HRM(hmr_lpar_lt, &kp, &lpar_lt, KEYS_L THUMBS)    // "    "   "   "
//MAKE_HRM(hmr_rpar_gt, &kp, &rpar_gt, KEYS_L THUMBS)    // "    "   "   "


ZMK_MOD_MORPH(smart_shft,
    bindings = <&sk LSHFT>, <&swedish_caps_word>;
    mods = <(MOD_LSFT)>;
)

ZMK_MACRO(rgb_ug_status_macro,
    bindings = <&rgb_ug RGB_STATUS>;
)




/* #define for key positions */

#define HYPER LC(LA(LEFT_GUI))

// cmd+Tab swapper, requires PR #1366
ZMK_TRI_STATE(swapper,
    bindings = <&kt LGUI>, <&kp TAB>, <&kt LGUI>;
    ignored-key-positions = <LT3>;
)

ZMK_TAP_DANCE(magic, bindings = <&mo MAGIC>, <&rgb_ug_status_macro>;)


/ {

    macros {


        Undo: Undo {
            compatible = "zmk,behavior-macro";
            #binding-cells = <0>;
            bindings = <&kp LG(Z)>;
            label = "UNDO";
        };

        Redo: Redo {
            compatible = "zmk,behavior-macro";
            #binding-cells = <0>;
            bindings = <&kp LS(LG(Z))>;
            label = "REDO";
        };

        tab_prev: tab_prev {
            compatible = "zmk,behavior-macro";
            #binding-cells = <0>;
            bindings = <&kp LA(LG(LEFT))>;
            label = "TAB_PREV";
        };

        tab_next: tab_next {
            compatible = "zmk,behavior-macro";
            #binding-cells = <0>;
            bindings = <&kp LA(LG(RIGHT))>;
            label = "TAB_NEXT";
        };

        nav_back: nav_back {
            compatible = "zmk,behavior-macro";
            #binding-cells = <0>;
            bindings = <&kp LG(LEFT)>;
            label = "NAV_BACK";
        };

        nav_fw: nav_fw {
            compatible = "zmk,behavior-macro";
            #binding-cells = <0>;
            bindings = <&kp LG(RIGHT)>;
            label = "NAV_FW";
        };
    };
};

#define _______________ 0x000000
#define HYPER_E &hml HYPER E
#define HYPER_I &hmr HYPER I
#define CTRL_A &hml  LCTRL A
#define ALT_S &hml LEFT_ALT S
#define CMD_D &hml LEFT_GUI D
#define SHIFT_F &hml LEFT_SHIFT F
#define SHIFT_J &hmr LEFT_SHIFT J
#define CMD_K &hmr LEFT_GUI K
#define ALT_L &hmr LEFT_ALT L
#define CTRL_P &hmr LEFT_CONTROL P
#define LCUR_BSPC &lt CURSOR BACKSPACE
#define LWORLD_RET &lt WORLD RETURN
#define LSYMBOL_SPC &lt SYMBOLS SPACE
#define LLOWER_ESC &lt LOWER ESC

GLV80_LAYER(Base, \
    /* ╭─────────────┬─────────────┬─────────────┬─────────────┬─────────────╮                               ╭─────────────┬─────────────┬─────────────┬─────────────┬─────────────╮ */
        &kp F1        &kp F2        &kp F3        &kp F4        &kp F5                                        &kp F6        &kp F7        &kp F8        &kp F9        &kp F10
    /* ├─────────────┼─────────────┼─────────────┼─────────────┼─────────────┼─────────────╮   ╭─────────────┼─────────────┼─────────────┼─────────────┼─────────────┼─────────────┤ */
        &kp SLASH     &kp N1        &kp N2        &kp N3        &kp N4        &kp N5            &kp N6        &kp N7        &kp N8        &kp N9        &kp N0        &kp MINUS
    /* ├─────────────┼─────────────┼─────────────┼─────────────┼─────────────┼─────────────┤   ├─────────────┼─────────────┼─────────────┼─────────────┼─────────────┼─────────────┤ */
        &kp TAB       &kp Q         &kp W         HYPER_E       &kp R         &kp T             &kp Y         &kp U         HYPER_I       &kp O         &kp SEMI      &kp SQT
    /* ├─────────────┼─────────────┼─────────────┼─────────────┼─────────────┼─────────────┤   ├─────────────┼─────────────┼─────────────┼─────────────┼─────────────┼─────────────┤ */
        &kp ESC       CTRL_A        ALT_S         CMD_D         SHIFT_F       &kp G             &kp H         SHIFT_J       CMD_K         ALT_L         CTRL_P        &kp EQUAL
    /* ├─────────────┼─────────────┼─────────────┼─────────────┼─────────────┼─────────────┤   ├─────────────┼─────────────┼─────────────┼─────────────┼─────────────┼─────────────┤ */
        &kp F11       &kp Z         &kp X         &kp C         &kp V         &kp B          ,  &kp N         &kp M         &kp COMMA     &kp DOT       &kp GRAVE     &kp F12
    /* ├─────────────┼─────────────┼─────────────┼─────────────┼─────────────┼─────────────╯   ╰─────────────┼─────────────┼─────────────┼─────────────┼─────────────┼─────────────┤ */
        &magic        &none         &none         &none         &mo MOUSE                    ,                &mo MOUSE     &sv_ao        &sv_ae        &sv_oe        &none
    /* ╰─────────────┴─────────────┴─────────────┴─────────────┴─────────────╯                               ╰─────────────┴─────────────┴─────────────┴─────────────┴─────────────╯ */
                                                                                             ,
    /*                                     ╭─────────────┬─────────────┬─────────────╮                   ╭─────────────┬─────────────┬─────────────╮                                     */
                                            &smart_shft   &kp UP        &kp DOWN                          &kp LEFT      &kp RIGHT     &kp TAB
    /*                                     ├─────────────┼─────────────┼─────────────┤      */ , /*      ├─────────────┼─────────────┼─────────────┤                                     */
                                            LCUR_BSPC     &kp DELETE    LLOWER_ESC                        LLOWER_ESC    &kp RETURN    LSYMBOL_SPC
    /*                                     ╰─────────────┴─────────────┴─────────────╯                   ╰─────────────┴─────────────┴─────────────╯                                     */
   )
#define BRGHT_DN &kp C_BRIGHTNESS_DEC
#define BRGHT_UP &kp C_BRIGHTNESS_INC
GLV80_LAYER(Media, \
 /* ╭───────────────┬───────────────┬───────────────┬───────────────┬───────────────╮                                   ╭───────────────┬───────────────┬───────────────┬───────────────┬───────────────╮ */
     BRGHT_DN        BRGHT_UP        &kp C_PREV       &kp C_PP       &kp C_NEXT                                          &trans          &trans           &kp C_MUTE     &kp C_VOL_DN    &kp C_VOL_UP
 /* ├───────────────┼───────────────┼───────────────┼───────────────┼───────────────┼───────────────╮   ╭───────────────┼───────────────┼───────────────┼───────────────┼───────────────┼───────────────┤ */
     &trans          &trans          &trans          &trans          &trans          &trans              &trans          &trans          &trans          &trans          &trans          &trans
 /* ├───────────────┼───────────────┼───────────────┼───────────────┼───────────────┼───────────────┤   ├───────────────┼───────────────┼───────────────┼───────────────┼───────────────┼───────────────┤ */
     &trans          &trans          &trans          &trans          &trans          &trans              &trans          &trans          &trans          &trans          &trans          &trans
 /* ├───────────────┼───────────────┼───────────────┼───────────────┼───────────────┼───────────────┤   ├───────────────┼───────────────┼───────────────┼───────────────┼───────────────┼───────────────┤ */
     &trans          &trans          &trans          &trans          &trans          &trans              &trans          &trans          &trans          &trans          &trans          &trans
 /* ├───────────────┼───────────────┼───────────────┼───────────────┼───────────────┼───────────────┤   ├───────────────┼───────────────┼───────────────┼───────────────┼───────────────┼───────────────┤ */
     &trans          &trans          &trans          &trans          &trans          &trans           ,  &trans          &trans          &trans          &trans          &trans          &trans
 /* ├───────────────┼───────────────┼───────────────┼───────────────┼───────────────┼───────────────╯   ╰───────────────┼───────────────┼───────────────┼───────────────┼───────────────┼───────────────┤ */
     &trans          &trans          &trans          &trans          &trans                           ,                  &trans          &trans          &trans          &trans          &trans
 /* ╰───────────────┴───────────────┴───────────────┴───────────────┴───────────────╯                                   ╰───────────────┴───────────────┴───────────────┴───────────────┴───────────────╯ */
                                                                                                      ,
 /*                                         ╭───────────────┬───────────────┬───────────────╮                   ╭───────────────┬───────────────┬───────────────╮                                         */
                                             &trans          &trans          &trans                              &trans          &trans          &trans
 /*                                         ├───────────────┼───────────────┼───────────────┤      */ , /*      ├───────────────┼───────────────┼───────────────┤                                         */
                                             &trans          &trans          &trans                              &trans          &trans          &trans
 /*                                         ╰───────────────┴───────────────┴───────────────╯                   ╰───────────────┴───────────────┴───────────────╯                                         */
)
GLV80_LAYER(Lower, \
 /* ╭───────────────┬───────────────┬───────────────┬───────────────┬───────────────╮                                   ╭───────────────┬───────────────┬───────────────┬───────────────┬───────────────╮ */
     &tog MEDIA      &to GAMING      &trans          &trans          &trans                                              &trans          &trans          &trans          &trans          &trans          /*
 /* ├───────────────┼───────────────┼───────────────┼───────────────┼───────────────┼───────────────╮   ╭───────────────┼───────────────┼───────────────┼───────────────┼───────────────┼───────────────┤ */
     &trans          &trans          &trans          &trans          &trans          &trans              &trans          &trans          &trans          &trans          &trans          &trans
 /* ├───────────────┼───────────────┼───────────────┼───────────────┼───────────────┼───────────────┤   ├───────────────┼───────────────┼───────────────┼───────────────┼───────────────┼───────────────┤ */
     &trans          &trans          &trans          &trans          &trans          &trans              &trans          &trans          &trans          &trans          &trans          &trans
 /* ├───────────────┼───────────────┼───────────────┼───────────────┼───────────────┼───────────────┤   ├───────────────┼───────────────┼───────────────┼───────────────┼───────────────┼───────────────┤ */
     &trans          &trans          &trans          &trans          &trans          &trans              &trans          &trans          &trans          &trans          &trans          &trans
 /* ├───────────────┼───────────────┼───────────────┼───────────────┼───────────────┼───────────────┤   ├───────────────┼───────────────┼───────────────┼───────────────┼───────────────┼───────────────┤ */
     &trans          &trans          &trans          &trans          &trans          &trans           ,  &trans          &trans          &trans          &trans          &trans          &trans
 /* ├───────────────┼───────────────┼───────────────┼───────────────┼───────────────┼───────────────╯   ╰───────────────┼───────────────┼───────────────┼───────────────┼───────────────┼───────────────┤ */
     &trans          &trans          &trans          &trans          &trans                           ,                  &trans          &trans          &trans          &trans          &trans
 /* ╰───────────────┴───────────────┴───────────────┴───────────────┴───────────────╯                                   ╰───────────────┴───────────────┴───────────────┴───────────────┴───────────────╯ */
                                                                                                      ,
 /*                                         ╭───────────────┬───────────────┬───────────────╮                   ╭───────────────┬───────────────┬───────────────╮                                         */
                                             &trans          &trans          &trans                              &trans          &trans          &trans
 /*                                         ├───────────────┼───────────────┼───────────────┤      */ , /*      ├───────────────┼───────────────┼───────────────┤                                         */
                                             &trans          &trans          &none                               &none          &trans          &trans
 /*                                         ╰───────────────┴───────────────┴───────────────╯                   ╰───────────────┴───────────────┴───────────────╯                                         */
)

GLV80_LAYER(Magic, \
 /* ╭───────────────┬───────────────┬───────────────┬───────────────┬───────────────╮                                   ╭───────────────┬───────────────┬───────────────┬───────────────┬───────────────╮ */
     &bt BT_CLR      &none           &none           &none           &none                                               &none           &none           &none           &none           &bt BT_CLR_ALL
/*  ├───────────────┼───────────────┼───────────────┼───────────────┼───────────────┼───────────────╮   ╭───────────────┼───────────────┼───────────────┼───────────────┼───────────────┼───────────────┤ */
     &none           &none           &none           &none           &none           &none               &none           &none           &none           &none           &none           &none
 /* ├───────────────┼───────────────┼───────────────┼───────────────┼───────────────┼───────────────┤   ├───────────────┼───────────────┼───────────────┼───────────────┼───────────────┼───────────────┤ */
     &none           &rgb_ug RGB_SPI &rgb_ug RGB_SAI &rgb_ug RGB_HUI &rgb_ug RGB_BRI &rgb_ug RGB_TOG     &none           &none           &none           &none           &none           &none
 /* ├───────────────┼───────────────┼───────────────┼───────────────┼───────────────┼───────────────┤   ├───────────────┼───────────────┼───────────────┼───────────────┼───────────────┼───────────────┤ */
     &bootloader     &rgb_ug RGB_SPD &rgb_ug RGB_SAD &rgb_ug RGB_HUD &rgb_ug RGB_BRD &rgb_ug RGB_EFF     &none           &none           &none           &none           &none           &bootloader
 /* ├───────────────┼───────────────┼───────────────┼───────────────┼───────────────┼───────────────┤   ├───────────────┼───────────────┼───────────────┼───────────────┼───────────────┼───────────────┤ */
     &sys_reset      &none           &none           &none           &none           &none            ,  &none           &none           &none           &none           &none           &sys_reset
 /* ├───────────────┼───────────────┼───────────────┼───────────────┼───────────────┼───────────────╯   ╰───────────────┼───────────────┼───────────────┼───────────────┼───────────────┼───────────────┤ */
     &none           &none           &none           &none           &none                            ,                  &none           &none           &none           &none           &none
 /* ╰───────────────┴───────────────┴───────────────┴───────────────┴───────────────╯                                   ╰───────────────┴───────────────┴───────────────┴───────────────┴───────────────╯ */
                                                                                                      ,
 /*                                         ╭───────────────┬───────────────┬───────────────╮                   ╭───────────────┬───────────────┬───────────────╮                                         */
                                             &bt_2           &bt_3           &none                               &none           &none           &none
 /*                                         ├───────────────┼───────────────┼───────────────┤      */ , /*      ├───────────────┼───────────────┼───────────────┤                                         */
                                             &bt_0           &bt_1           &out OUT_USB                        &none           &none           &none
 /*                                         ╰───────────────┴───────────────┴───────────────╯                   ╰───────────────┴───────────────┴───────────────╯                                         */

)

GLV80_LAYER(Cursor, \
 /* ╭───────────────┬───────────────┬───────────────┬───────────────┬───────────────╮                                   ╭───────────────┬───────────────┬───────────────┬───────────────┬───────────────╮ */
     &none           &none           &none           &none           &none                                               &none           &none           &none           &none          &none
/*  ├───────────────┼───────────────┼───────────────┼───────────────┼───────────────┼───────────────╮   ╭───────────────┼───────────────┼───────────────┼───────────────┼───────────────┼───────────────┤ */
     &none           &none           &none           &none           &none           &none               &none           &none           &none           &none           &none           &none
 /* ├───────────────┼───────────────┼───────────────┼───────────────┼───────────────┼───────────────┤   ├───────────────┼───────────────┼───────────────┼───────────────┼───────────────┼───────────────┤ */
     &none           &none           &none           &none           &none           &none               &none           &Undo           &Redo           &none           &none           &none
 /* ├───────────────┼───────────────┼───────────────┼───────────────┼───────────────┼───────────────┤   ├───────────────┼───────────────┼───────────────┼───────────────┼───────────────┼───────────────┤ */
     &none           &kp LCTRL       &kp LALT        &kp LGUI        &kp LSHIFT      &none               &kp LEFT        &kp DOWN        &kp UP          &kp RIGHT       &none           &none
 /* ├───────────────┼───────────────┼───────────────┼───────────────┼───────────────┼───────────────┤   ├───────────────┼───────────────┼───────────────┼───────────────┼───────────────┼───────────────┤ */
     &none           &none           &none           &none           &none           &none            ,  &kp LG(LEFT)    &kp LG(LA(LEFT))  &kp LG(LA(RIGHT))  &kp LG(RIGHT)        &none           &none
 /* ├───────────────┼───────────────┼───────────────┼───────────────┼───────────────┼───────────────╯   ╰───────────────┼───────────────┼───────────────┼───────────────┼───────────────┼───────────────┤ */
     &none           &none           &none           &none           &none                            ,                  &none           &none           &none           &none           &none
 /* ╰───────────────┴───────────────┴───────────────┴───────────────┴───────────────╯                                   ╰───────────────┴───────────────┴───────────────┴───────────────┴───────────────╯ */
                                                                                                      ,
 /*                                         ╭───────────────┬───────────────┬───────────────╮                   ╭───────────────┬───────────────┬───────────────╮                                         */
                                             &none           &none           &none                               &none           &none           &none
 /*                                         ├───────────────┼───────────────┼───────────────┤      */ , /*      ├───────────────┼───────────────┼───────────────┤                                         */
                                             &none           &none           &none                               &none           &none           &swapper
 /*                                         ╰───────────────┴───────────────┴───────────────╯                   ╰───────────────┴───────────────┴───────────────╯                                         */
)
GLV80_LAYER(World, \
 /* ╭───────────────┬───────────────┬───────────────┬───────────────┬───────────────╮                                   ╭───────────────┬───────────────┬───────────────┬───────────────┬───────────────╮ */
     &none            &none           &none           &none           &none                                               &none           &none           &none           &none          &none
/*  ├───────────────┼───────────────┼───────────────┼───────────────┼───────────────┼───────────────╮   ╭───────────────┼───────────────┼───────────────┼───────────────┼───────────────┼───────────────┤ */
     &none           &none           &none           &none           &none           &none               &none           &none           &none           &none           &none           &none
 /* ├───────────────┼───────────────┼───────────────┼───────────────┼───────────────┼───────────────┤   ├───────────────┼───────────────┼───────────────┼───────────────┼───────────────┼───────────────┤ */
     &none           &none           &none           &none           &none           &none               &none           &none           &none           &none           &none           &none
 /* ├───────────────┼───────────────┼───────────────┼───────────────┼───────────────┼───────────────┤   ├───────────────┼───────────────┼───────────────┼───────────────┼───────────────┼───────────────┤ */
     &none           &none           &sv_ao          &sv_ae          &sv_oe          &none               &none           &trans          &none           &none           &none           &none
 /* ├───────────────┼───────────────┼───────────────┼───────────────┼───────────────┼───────────────┤   ├───────────────┼───────────────┼───────────────┼───────────────┼───────────────┼───────────────┤ */
     &none           &none           &none           &none           &none           &none            ,  &none           &none           &none           &none           &none           &none
 /* ├───────────────┼───────────────┼───────────────┼───────────────┼───────────────┼───────────────╯   ╰───────────────┼───────────────┼───────────────┼───────────────┼───────────────┼───────────────┤ */
     &none           &none           &none           &none           &none                            ,                  &none           &none           &none           &none           &none
 /* ╰───────────────┴───────────────┴───────────────┴───────────────┴───────────────╯                                   ╰───────────────┴───────────────┴───────────────┴───────────────┴───────────────╯ */
                                                                                                      ,
 /*                                         ╭───────────────┬───────────────┬───────────────╮                   ╭───────────────┬───────────────┬───────────────╮                                         */
                                             &none           &none           &none                               &none           &none           &none
 /*                                         ├───────────────┼───────────────┼───────────────┤      */ , /*      ├───────────────┼───────────────┼───────────────┤                                         */
                                             &none           &none           &none                               &none           &none           &none
 /*                                         ╰───────────────┴───────────────┴───────────────╯                   ╰───────────────┴───────────────┴───────────────╯                                         */

)

#define LPAREN &kp LEFT_PARENTHESIS
#define RPAREN &kp RIGHT_PARENTHESIS

GLV80_LAYER(Symbols, \
 /* ╭───────────────┬───────────────┬───────────────┬───────────────┬───────────────╮                                   ╭───────────────┬───────────────┬───────────────┬───────────────┬───────────────╮ */
     &trans          &trans          &trans          &trans          &trans                                               &trans         &trans          &trans          &trans          &trans
 /* ├───────────────┼───────────────┼───────────────┼───────────────┼───────────────┼───────────────╮   ╭───────────────┼───────────────┼───────────────┼───────────────┼───────────────┼───────────────┤ */
     &kp QUESTION    &kp EXCL        &kp AT          &kp POUND       &kp DOLLAR      &kp PERCENT         &kp CARET       &kp AMPS        &kp ASTERISK    &trans          &trans          &trans
 /* ├───────────────┼───────────────┼───────────────┼───────────────┼───────────────┼───────────────┤   ├───────────────┼───────────────┼───────────────┼───────────────┼───────────────┼───────────────┤ */
     &trans          &kp LT          &kp BACKSLASH   &kp SLASH       &kp GT          &kp TILDE           &kp COLON       &kp AMPS        &kp PIPE        &trans          &trans          &trans
 /* ├───────────────┼───────────────┼───────────────┼───────────────┼───────────────┼───────────────┤   ├───────────────┼───────────────┼───────────────┼───────────────┼───────────────┼───────────────┤ */
     &kp LEFT_BRACKET &kp LEFT_BRACE LPAREN          RPAREN         &kp RIGHT_BRACE &kp RIGHT_BRACKET   &kp SEMI       &kp BACKSPACE   &kp TAB        &kp SPACE      &trans          &trans
 /* ├───────────────┼───────────────┼───────────────┼───────────────┼───────────────┼───────────────┤   ├───────────────┼───────────────┼───────────────┼───────────────┼───────────────┼───────────────┤ */
     &trans          &trans          &kp EQUAL       &kp UNDER       &kp PLUS        &kp MINUS        ,  &trans          &kp DEL         &kp LS(TAB)     &kp ENTER       &trans          &trans
 /* ├───────────────┼───────────────┼───────────────┼───────────────┼───────────────┼───────────────╯   ╰───────────────┼───────────────┼───────────────┼───────────────┼───────────────┼───────────────┤ */
     &none           &none           &none           &none           &none                            ,                  &none           &none           &none           &none           &none
 /* ╰───────────────┴───────────────┴───────────────┴───────────────┴───────────────╯                                   ╰───────────────┴───────────────┴───────────────┴───────────────┴───────────────╯ */
                                                                                                      ,
 /*                                         ╭───────────────┬───────────────┬───────────────╮                   ╭───────────────┬───────────────┬───────────────╮                                         */
                                             &none           &none           &none                               &none           &none           &none
 /*                                         ├───────────────┼───────────────┼───────────────┤      */ , /*      ├───────────────┼───────────────┼───────────────┤                                         */
                                             &kp SQT         &kp DOUBLE_QUOTES  &kp GRAVE                        &none           &none           &none
 /*                                         ╰───────────────┴───────────────┴───────────────╯                   ╰───────────────┴───────────────┴───────────────╯                                         */
)
GLV80_LAYER(Mouse, \
 /* ╭───────────────┬───────────────┬───────────────┬───────────────┬───────────────╮                                   ╭───────────────┬───────────────┬───────────────┬───────────────┬───────────────╮ */
     &none           &none           &none           &none           &none                                               &none           &none           &none           &none           &none
 /* ├───────────────┼───────────────┼───────────────┼───────────────┼───────────────┼───────────────╮   ╭───────────────┼───────────────┼───────────────┼───────────────┼───────────────┼───────────────┤ */
     &none           &none           &none           &none           &none           &none               &none           &none           &none           &none           &none           &none
 /* ├───────────────┼───────────────┼───────────────┼───────────────┼───────────────┼───────────────┤   ├───────────────┼───────────────┼───────────────┼───────────────┼───────────────┼───────────────┤ */
     &none           &none           U_WH_L          U_MS_U          U_WH_R          U_WH_U              U_WH_L          U_WH_D          U_WH_U          U_WH_R          &none           &none
 /* ├───────────────┼───────────────┼───────────────┼───────────────┼───────────────┼───────────────┤   ├───────────────┼───────────────┼───────────────┼───────────────┼───────────────┼───────────────┤ */
     &none           &none           U_MS_L          U_MS_D          U_MS_R          U_WH_D              U_MS_L          U_MS_D          U_MS_U          U_MS_R          &none          &none
 /* ├───────────────┼───────────────┼───────────────┼───────────────┼───────────────┼───────────────┤   ├───────────────┼───────────────┼───────────────┼───────────────┼───────────────┼───────────────┤ */
     &none           &none           &none           &none           &none           &none            ,  &none           &none           &none           &none           &none           &none
 /* ├───────────────┼───────────────┼───────────────┼───────────────┼───────────────┼───────────────╯   ╰───────────────┼───────────────┼───────────────┼───────────────┼───────────────┼───────────────┤ */
     &none           &none           &none           &none           &none                            ,                  &none           &none           &none           &none           &none
 /* ╰───────────────┴───────────────┴───────────────┴───────────────┴───────────────╯                                   ╰───────────────┴───────────────┴───────────────┴───────────────┴───────────────╯ */
                                                                                                      ,
 /*                                         ╭───────────────┬───────────────┬───────────────╮                   ╭───────────────┬───────────────┬───────────────╮                                         */
                                             &none           &none           &none                               &none           &none           &none
 /*                                         ├───────────────┼───────────────┼───────────────┤      */ , /*      ├───────────────┼───────────────┼───────────────┤                                         */
                                             U_CLK_L         U_CLK_R         &none                               &none           U_CLK_L         U_CLK_R
 /*                                         ╰───────────────┴───────────────┴───────────────╯                   ╰───────────────┴───────────────┴───────────────╯                                         */
)

GLV80_LAYER(Gaming, \
 /* ╭───────────────┬───────────────┬───────────────┬───────────────┬───────────────╮                                   ╭───────────────┬───────────────┬───────────────┬───────────────┬───────────────╮ */
     &kp F1          &kp F2          &kp F3          &kp F4          &kp F5                                              &kp F6          &kp F7          &kp F8          &kp F9          &kp F10
 /* ├───────────────┼───────────────┼───────────────┼───────────────┼───────────────┼───────────────╮   ╭───────────────┼───────────────┼───────────────┼───────────────┼───────────────┼───────────────┤ */
     &kp EQUAL       &kp N1          &kp N2          &kp N3          &kp N4          &kp N5              &kp N6          &kp N7          &kp N8          &kp N9          &kp N0          &kp MINUS
 /* ├───────────────┼───────────────┼───────────────┼───────────────┼───────────────┼───────────────┤   ├───────────────┼───────────────┼───────────────┼───────────────┼───────────────┼───────────────┤ */
     &kp MINUS       &kp TILDE       &kp B           &kp N           &kp M           &kp SQT             &kp B           &kp N           &kp M           &kp COMMA       &kp PERIOD      &kp BACKSLASH
 /* ├───────────────┼───────────────┼───────────────┼───────────────┼───────────────┼───────────────┤   ├───────────────┼───────────────┼───────────────┼───────────────┼───────────────┼───────────────┤ */
     &kp T           &kp TAB         &kp Q           &kp W           &kp E           &kp R               &kp T           &kp Y           &kp U           &kp I           &kp O          &kp P
 /* ├───────────────┼───────────────┼───────────────┼───────────────┼───────────────┼───────────────┤   ├───────────────┼───────────────┼───────────────┼───────────────┼───────────────┼───────────────┤ */
     &kp G           &kp LSHIFT      &kp A           &kp S           &kp D           &kp F            ,  &kp G           &kp H           &kp J           &kp K           &kp L           &kp SEMI
 /* ├───────────────┼───────────────┼───────────────┼───────────────┼───────────────┼───────────────╯   ╰───────────────┼───────────────┼───────────────┼───────────────┼───────────────┼───────────────┤ */
     &magic          &kp LCTRL       &kp Z           &kp X           &kp C                            ,                  &none           &none           &none           &none           &none
 /* ╰───────────────┴───────────────┴───────────────┴───────────────┴───────────────╯                                   ╰───────────────┴───────────────┴───────────────┴───────────────┴───────────────╯ */
                                                                                                      ,
 /*                                         ╭───────────────┬───────────────┬───────────────╮                   ╭───────────────┬───────────────┬───────────────╮                                         */
                                             &kp ESC         &kp RETURN      &none                               &kp BACKSPACE   &kp DEL         &kp RETURN
 /*                                         ├───────────────┼───────────────┼───────────────┤      */ , /*      ├───────────────┼───────────────┼───────────────┤                                         */
                                             &kp SPACE       &kp LALT        &kp LGUI                            &to BASE        &kp TAB         &kp SPACE
 /*                                         ╰───────────────┴───────────────┴───────────────╯                   ╰───────────────┴───────────────┴───────────────╯                                         */
)
